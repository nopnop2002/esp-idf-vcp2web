## main/Kconfig.projbuild
```kconfig
menu "Application Configuration"

	menu "WiFi Setting"

		config ESP_WIFI_SSID
			string "WiFi SSID"
			default "myssid"
			help
				SSID (network name) for the example to connect to.

		config ESP_WIFI_PASSWORD
			string "WiFi Password"
			default "mypassword"
			help
				WiFi password (WPA or WPA2) for the example to use.

		config ESP_MAXIMUM_RETRY
			int "Maximum retry"
			default 5
			help
				Set the Maximum retry to avoid station reconnecting to the AP unlimited when the AP is really inexistent.

		config MDNS_HOSTNAME
			string "mDNS Hostname"
			default "esp32-server"
			help
				The mDNS host name used by the ESP32.

	endmenu

	menu "NTP Setting"

		config NTP_SERVER
			string "NTP Server"
			default "pool.ntp.org"
			help
				Hostname for NTP Server.

		config LOCAL_TIMEZONE
			int "Your TimeZone"
			range -23 23
			default 0
			help
				Your local timezone.	When it is 0, Greenwich Mean Time.

	endmenu

	menu "VCP Setting"

		config VCP_BAUDRATE
			int "VCP communication speed"
			range 1200 115200
			default 115200
			help
				VCP communication speed.

		config VCP_STOP_BITS
			int "VCP communication stop bits"
			range 0 2
			default 0
			help
				VCP communication stop bits. 0: 1 stopbit, 1: 1.5 stopbits, 2: 2 stopbits

		config VCP_PARITY
			int "VCP communication parity"
			range 0 4
			default 0
			help
				VCP communication parity. 0: None, 1: Odd, 2: Even, 3: Mark, 4: Space

		config VCP_DATA_BITS
			int "VCP communication data bits"
			default 8
			help
				VCP communication data bits.

	endmenu

endmenu
```
